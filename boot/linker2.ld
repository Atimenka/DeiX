/* linker2.ld — линкует stage2 (32-бит) + long_mode_init (64-бит) + ядро
   на Rust в один плоский (raw binary) образ, начиная с физического адреса
   0x10000 — именно туда boot_sector.asm загружает stage2 с диска. */

ENTRY(stage2_start)

SECTIONS {
    . = 0x10000;

    .text :
    {
        *(.text .text.*)
    }

    .rodata :
    {
        *(.rodata .rodata.*)
    }

    .data :
    {
        *(.data .data.*)
    }

    /* Куча ядра (HEAP_STORAGE, см. src/allocator.rs) должна физически
       начинаться выше 1 МиБ, ЗА пределами классической PC-"дыры" памяти
       0xA0000-0xFFFFF (640 КиБ - 1 МиБ), зарезервированной под legacy VGA
       framebuffer (0xA0000-0xBFFFF) и теневую память BIOS/опциональных
       ROM (0xC0000-0xFFFFF). Чтение/запись по этим физическим адресам НЕ
       ведёт себя как обычная RAM даже при полном идентити-маппинге
       страниц — там установлен MMIO-alias на видеопамять (в QEMU это
       hw/display/vga.c, chain4-режим старого текстового VGA), который
       перехватывает обращения независимо от того, что процессор думает,
       что пишет в обычную память ядра.

       Раньше вся куча (16 МиБ) естественным образом размещалась линкером
       сразу после маленького ассемблерного .bss (таблицы страниц + стек,
       ~56 КиБ, начинающегося на 0x35000) — то есть примерно с 0x43000 до
       0x1043000, ПОЛНОСТЬЮ перекрывая опасный диапазон 0xA0000-0xFFFFF.
       Когда графический back buffer (Renderer, см. renderer.rs) выделялся
       из кучи и его физический адрес попадал внутрь этой дыры, записанные
       туда пиксели либо не сохранялись, либо читались обратно как
       "чужие" байты видеокарты (в т.ч. остатки старого текстового
       VGA-шрифта) — именно это проявлялось как загадочный шум/полосы на
       экране в графическом режиме, причём не на каждой сборке (конкретный
       адрес back buffer зависит от истории всех аллокаций кучи до него).

       Решение: явно "перепрыгиваем" адрес счётчика линкера на 0x200000
       (2 МиБ) МЕЖДУ ассемблерным .bss (маленький, безопасно помещается
       ниже 1 МиБ) и Rust-частью .bss (которая содержит HEAP_STORAGE) —
       см. per-object-file селекторы ниже. Это чисто адресная операция
       внутри NOBITS-секции (.bss целиком остаётся NOBITS, включая этот
       "прыжок") — она не добавляет ни одного байта в итоговый файл
       образа диска, только резервирует физическое адресное пространство.
    */
    .bss :
    {
        __bss_start = .;
        *stage2.o(.bss .bss.*)
        *long_mode_init.o(.bss .bss.*)
        . = 0x200000;
        *(.bss .bss.*)
        __bss_end = .;
    }
}

